## config/boards/shields/corne_with_dongle/Kconfig.defconfig
```kconfig
# Copyright (c) 2020 The ZMK Contributors
# SPDX-License-Identifier: MIT

if SHIELD_CORNE_WITH_DONGLE_CENTRAL

config ZMK_KEYBOARD_NAME
	default "CorneWithDongle"
	
config ZMK_SPLIT_BLE_ROLE_CENTRAL
	default y
	
config ZMK_USB
	default y

endif

if SHIELD_CORNE_WITH_DONGLE_LEFT || SHIELD_CORNE_WITH_DONGLE_RIGHT || SHIELD_CORNE_WITH_DONGLE_CENTRAL 

config ZMK_SPLIT
	default y

config ZMK_BLE
	default y
	
endif
```

## config/boards/shields/corne_with_dongle/Kconfig.shield
```kconfig
# Copyright (c) 2020 The ZMK Contributors
# SPDX-License-Identifier: MIT

config SHIELD_CORNE_WITH_DONGLE_LEFT
	def_bool $(shields_list_contains,corne_with_dongle_left)

config SHIELD_CORNE_WITH_DONGLE_RIGHT
	def_bool $(shields_list_contains,corne_with_dongle_right)

config SHIELD_CORNE_WITH_DONGLE_CENTRAL
	def_bool $(shields_list_contains,corne_with_dongle_central)
```
